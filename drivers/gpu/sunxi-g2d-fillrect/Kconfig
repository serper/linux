## drivers/gpu/sunxi-g2d-fillrect/Kconfig
```kconfig
# SPDX-License-Identifier: GPL-2.0-only
config SUNXI_G2D_FILLRECT_TEST
	tristate "Allwinner G2D RCQ fillrect self-test driver"
	depends on (ARM || ARM64) && HAS_IOMEM
	select DMA_COHERENT_POOL
	help
	  Build a minimal platform driver that brings up the Allwinner G2D
	  engine in RCQ mode and submits a single fill-rectangle command during
	  probe. The driver logs every stage (clock/reset enable, RCQ header
	  programming, STATUS polling) so that the hardware behaviour can be
	  diagnosed without touching the production BSP.

	  The driver is intended only for bring-up and hardware validation on
	  SoCs such as the T113-S3. It allocates its own test surface, performs
	  a 64x64 ARGB fill via RCQ and reports the observed status bits. No
	  user-space ABI is exposed.

	  Say Y here if you want to exercise the RCQ engine directly from the
	  kernel log for debugging purposes. The module can also be built
	  externally with M=m.
```

## drivers/gpu/sunxi-g2d-m2m/Kconfig
```kconfig
config SUNXI_G2D_M2M
	tristate "Allwinner Sunxi G2D memory-to-memory 2D engine driver"
 	depends on VIDEO_DEV && V4L2_MEM2MEM_DEV && VIDEO_V4L2 && OF && COMMON_CLK && HAS_DMA && MMU
	select VIDEOBUF2_DMA_CONTIG
	select V4L2_MEM2MEM_DEV
 	help
	  help
	  V4L2 mem2mem driver for the Allwinner G2D 2D accelerator (BLIT/SCALE/ROTATE).
	  This driver starts minimal: XRGB8888 → XRGB8888, non-mplane, OUTPUT->CAPTURE.
	  Later we can add NV12 mplane, rotations and Porter-Duff alpha.

	  Say Y to build it into the kernel or M to build as a module.
```

## drivers/gpu/sunxi-g2d/Kconfig
```kconfig
# SPDX-License-Identifier: GPL-2.0-only
config DRM_SUN8I_G2D
	tristate "Allwinner G2D 2D Graphics Accelerator"
	depends on (ARM || ARM64) && HAS_IOMEM
	select DMA_SHARED_BUFFER
	help
	  Choose this option if you have an Allwinner SoC with the G2D
	  2D graphics accelerator (T113, D1, etc.).
	  
	  This driver provides a character device (/dev/g2d) with custom
	  UAPI ioctls optimized for UI/graphics acceleration. It supports:
	  - Hardware-accelerated blits and fills
	  - DMA-BUF import/export for zero-copy
	  - Sync fences for coordination with DRM/GPU
	  - Rotation, scaling, and format conversion
	  
	  To compile this driver as a module, choose M here: the module
	  will be called sunxi-g2d.
```
